## components/config_store/Kconfig
```kconfig
menu "Pumpkin configuration store"

    config PUMPKIN_TRIGGER_MM
        int "Distanza di trigger radar (mm)"
        default 1200
        range 100 10000
        help
            Distanza massima a cui la zucca scatta in modalita automatica.

    config PUMPKIN_COOLDOWN_S
        int "Cooldown tra due trigger (s)"
        default 30
        range 0 3600
        help
            Pausa minima tra due attivazioni consecutive dello scare.

    config PUMPKIN_TRIGGER_DURATION_S
        int "Durata dell'animazione di trigger (s)"
        default 8
        range 1 3600
        help
            Quanto dura l'effetto di scare prima di tornare all'idle.

    config PUMPKIN_TRIGGER_ANIM
        string "Nome effetto di trigger (registry led_effects)"
        default "scare"

    config PUMPKIN_IDLE_ANIM
        string "Nome effetto di idle (registry led_effects)"
        default "candle"

    config PUMPKIN_IDLE_BRIGHTNESS_PCT
        int "Luminosita idle (%)"
        default 10
        range 0 100

    config PUMPKIN_MAX_BRIGHTNESS_PCT
        int "Luminosita massima assoluta (%)"
        default 60
        range 5 100
        help
            Cap di sicurezza del rail 5 V, vale per tutti gli effetti.

    config PUMPKIN_AUTO_MODE
        bool "Modalita automatica al boot"
        default y
        help
            Se attiva, il trigger radar guida il passaggio idle->scare.

    config PUMPKIN_COLOR_R
        int "Colore di trigger, canale R (0-255)"
        default 255

    config PUMPKIN_COLOR_G
        int "Colore di trigger, canale G (0-255)"
        default 120

    config PUMPKIN_COLOR_B
        int "Colore di trigger, canale B (0-255)"
        default 0

    config PUMPKIN_BRIGHTNESS_PCT
        int "Luminosita durante il trigger (%)"
        default 100
        range 0 100

    config PUMPKIN_EYES_ENABLED
        bool "Occhi attivi al boot"
        default y
        help
            Zona occhi: 2 LED WS2812B in coda ai 64 pixel del corpo
            (pixel 64-65, stesso pin dati).

    config PUMPKIN_EYES_IDLE_COLOR_R
        int "Colore idle occhi, canale R (0-255)"
        default 255

    config PUMPKIN_EYES_IDLE_COLOR_G
        int "Colore idle occhi, canale G (0-255)"
        default 120

    config PUMPKIN_EYES_IDLE_COLOR_B
        int "Colore idle occhi, canale B (0-255)"
        default 0

    config PUMPKIN_EYES_SCARE_COLOR_R
        int "Colore scare occhi, canale R (0-255)"
        default 255

    config PUMPKIN_EYES_SCARE_COLOR_G
        int "Colore scare occhi, canale G (0-255)"
        default 0

    config PUMPKIN_EYES_SCARE_COLOR_B
        int "Colore scare occhi, canale B (0-255)"
        default 0

    config PUMPKIN_EYES_IDLE_EFFECT
        string "Nome effetto idle occhi (registry led_effects)"
        default "breathe"

    config PUMPKIN_EYES_IDLE_BRIGHTNESS_PCT
        int "Luminosita idle occhi (%)"
        default 40
        range 0 100

    config PUMPKIN_EYES_SCARE_BRIGHTNESS_PCT
        int "Luminosita scare occhi (%)"
        default 100
        range 0 100

    config PUMPKIN_EYES_FOLLOW_FSM
        bool "Occhi seguono la FSM (idle/scare)"
        default y
        help
            Se attivo, il look degli occhi segue le transizioni
            idle/scare della FSM; altrimenti resta sul look idle.

    config STORE_DEBOUNCE_MS
        int "Debounce del commit NVS (ms)"
        default 2000
        range 100 60000
        help
            Ritardo tra l'ultima modifica e la scrittura su NVS per
            limitare l'usura della flash; config_store_flush committa
            subito.

endmenu
```

## components/ha_mqtt/Kconfig
```kconfig
menu "HA MQTT"

config PUMPKIN_MQTT_KEEPALIVE_S
    int "Keepalive MQTT (s)"
    range 5 300
    default 30
    help
        Entro questo tempo HA segna offline il device dopo uno scollegamento.

config HA_MQTT_WORKER_WDT
    bool "Iscrivi il task worker al task watchdog"
    default y
    help
        Il worker attende sulla coda comandi a passi da 1 s (anziche' per
        sempre) e si alimenta a ogni passo: la semantica non cambia, nessun
        comando viene perso durante i timeout.

choice PUMPKIN_MQTT_CA
    prompt "Origine certificato CA per mqtts://"
    default PUMPKIN_MQTT_CA_NONE
    config PUMPKIN_MQTT_CA_NONE
        bool "Nessuna (solo mqtt://)"
    config PUMPKIN_MQTT_CA_NVS
        bool "Blob PEM in NVS (namespace pumpkin_ca)"
    config PUMPKIN_MQTT_CA_PARTITION
        bool "Partizione dati con PEM"
endchoice

config PUMPKIN_MQTT_CA_PART
    string "Etichetta partizione CA"
    depends on PUMPKIN_MQTT_CA_PARTITION
    default "mqtt_ca"

endmenu
```

## components/led_effects/Kconfig
```kconfig
menu "LED Effects"

    config LED_FX_NUM_PIXELS
        int "Numero di pixel della catena LED (matrice 8x8 + occhi)"
        default 66
        range 1 1024
        help
            64 LED WS2812B della matrice 8x8 (catena DIN unica a serpentina:
            pixel 0 in alto a sinistra, righe pari sx->dx, righe dispari
            dx->sx) + 2 LED WS2812B "occhi" in coda alla stessa linea dati
            (pixel 64-65, vedi LED_FX_EYES_START).

    config LED_FX_EYES_START
        int "Primo pixel della zona occhi"
        default 64
        range 0 1022
        help
            Primo dei 2 pixel occhi nella catena: la zona occhi occupa
            [LED_FX_EYES_START, LED_FX_EYES_START+2) e il corpo e'
            [0, LED_FX_EYES_START).

    config LED_FX_EYES_DESYNC
        bool "Sfasamento tra i due occhi"
        default y
        help
            Con y l'occhio 1 segue la timeline dell'occhio 0 in ritardo:
            300 ms su breathe/color_cycle, 130 ms sulla finestra di blink.
            Con n i due occhi sono perfettamente sincroni.

    config LED_FX_EYES_TRANSITION_MS
        int "Transizione colore base occhi (ms)"
        default 1500
        range 100 10000
        help
            Durata del lerp lineare del colore base della zona occhi verso
            il target: il passaggio colore scare -> colore idle del piano
            COOLDOWN (e ogni led_fx_eyes_set_color) e' progressivo.

    config LED_FX_DATA_GPIO
        int "GPIO linea dati LED"
        default 5

    config LED_FX_EN_GPIO
        int "GPIO abilitazione rail LED (LED_EN)"
        default 4

    choice LED_FX_COLOR_ORDER
        prompt "Ordine colore del LED"
        default LED_FX_ORDER_GRB
        config LED_FX_ORDER_GRB
            bool "GRB (WS2812B)"
        config LED_FX_ORDER_RGB
            bool "RGB"
    endchoice

    config LED_FX_RGBW
        bool "Striscia RGBW (SK6812)"
        default n

    config LED_FX_MAX_BRIGHTNESS_PCT
        int "Luminosita massima assoluta (%)"
        default 60
        range 5 100

    config LED_FX_FPS
        int "Frame rate del task anim (fps)"
        default 60
        range 10 120

    config LED_FX_TASK_WDT
        bool "Iscrivi il task anim al task watchdog"
        default y
        help
            Il task anim si alimenta a ogni frame (periodo ~16 ms): un
            blocco oltre il timeout produce il warning (o panic, se
            configurato) del watchdog invece di una zucca congelata.

endmenu
```

## components/net_mgr/Kconfig
```kconfig
menu "Pumpkin network manager"

    config PUMPKIN_NET_HOSTNAME_PREFIX
        string "Prefisso hostname netif/mDNS"
        default "pumpkin"
        help
            L'hostname completo e il prefisso piu i 3 byte finali del MAC
            STA in esadecimale minuscolo (es. pumpkin-a1b2c3).

    config PUMPKIN_NET_PS_MIN_MODEM
        bool "Power save Wi-Fi min modem allo start"
        default y
        help
            Se attiva, net_mgr applica WIFI_PS_MIN_MODEM dopo lo start per
            ridurre i consumi; net_mgr_set_power_save lo commuta a runtime
            per la verifica di latenza a banco.

    config PUMPKIN_NET_LISTEN_INTERVAL
        int "Listen interval (in beacon)"
        default 3
        range 1 10
        help
            Scritto in wifi_config_t.sta prima dello start: quante beacon
            la stazione puo saltare in power save (piu alto, meno risvegli
            radio e piu latenza).

    config PUMPKIN_NET_BACKOFF_MAX_MS
        int "Cap del backoff di riconnessione (ms)"
        default 60000
        range 1000 3600000
        help
            Ritardo massimo tra due tentativi di riconnessione: il backoff
            parte da 1000 ms, raddoppia a ogni tentativo con jitter +/-15%
            e non supera mai questo valore.

    config PUMPKIN_NET_DIAG_PERIOD_S
        int "Periodo del log diagnostico (s)"
        default 30
        range 5 3600
        help
            Ogni quanto il timer diagnostico campiona rssi/canale, li
            registra in log e aggiorna i record TXT mDNS.

endmenu
```

## components/pumpkin_fsm/Kconfig
```kconfig
menu "Pumpkin FSM"

    config PUMPKIN_FSM_TASK_STACK_SIZE
        int "Stack del task FSM (byte)"
        default 4096
        help
            Stack del task proprietario che processa la coda degli eventi
            della macchina a stati.

    config PUMPKIN_FSM_TASK_PRIO
        int "Priorita del task FSM"
        default 4
        help
            Priorita FreeRTOS del task FSM (sotto il task radar, che usa 5).

    config PUMPKIN_FSM_QUEUE_LEN
        int "Lunghezza della coda eventi FSM"
        default 16
        help
            Numero massimo di eventi in attesa: oltre, gli eventi nuovi
            vengono scartati con un log di warning.

    config FSM_TASK_WDT
        bool "Iscrivi il task FSM al task watchdog"
        default y
        help
            Il task proprietario FSM attende sulla coda a passi da 1 s
            (anziche' per sempre) e si alimenta a ogni passo: nessun evento
            viene perso durante i timeout, la semantica resta identica.

endmenu
```

## components/pumpkin_ota/Kconfig
```kconfig
menu "Pumpkin OTA"

config PUMPKIN_OTA_MIN_FREE_HEAP
    int "Heap libero e largest block minimi per TLS+OTA (byte)"
    range 16384 262144
    default 65536
    help
        Un aggiornamento scarica l'immagine via HTTPS (TLS + buffer 4K) e
        scrive su flash: sotto questa soglia di heap libero (o di massima
        allocazione contigua) l'update viene rifiutato con "heap_low".

config PUMPKIN_OTA_MAX_LED_CURRENT_MA
    int "Corrente LED massima consentita durante l'OTA (mA)"
    range 0 5000
    default 500
    help
        Se la stima corrente del rail LED (led_fx_estimate_current_ma)
        supera questa soglia l'update viene rifiutato con
        "led_full_light": si presume il rail a piena luce e si evita di
        combinare il picco di corrente della scrittura flash con quello
        dei LED.

config PUMPKIN_OTA_TASK_WDT
    bool "Iscrivi il task OTA al task watchdog"
    default y
    help
        Il task OTA chiama esp_task_wdt_reset() a ogni iterazione del
        download: se il download si blocca oltre il timeout del TWDT
        (5 s in Fase 7) il watchdog riavvia la board.

endmenu
```

## components/radar_ld2410/Kconfig
```kconfig
menu "Radar LD2410"

    config RADAR_UART_NUM
        int "UART periferica del radar"
        default 1
        range 0 2

    config RADAR_BAUD
        int "Baud rate (default di fabbrica del modulo: 256000)"
        default 256000

    config RADAR_RX_GPIO
        int "GPIO RX (collegato al TX del radar)"
        default 26

    config RADAR_TX_GPIO
        int "GPIO TX (collegato all'RX del radar)"
        default 27

    config RADAR_OUT_GPIO
        int "GPIO del pin OUT del radar"
        default 25

    config RADAR_OUT_ENABLE
        bool "Usa il pin OUT come controllo incrociato / modalita degradata"
        default y

    config RADAR_EN_GPIO
        int "GPIO RADAR_EN (-1 = non cablato)"
        default -1
        range -1 48

    config RADAR_RX_BUFFER
        int "Buffer RX UART [byte]"
        default 1024
        range 1024 8192

    config RADAR_TRIGGER_MM
        int "Distanza di trigger [mm]"
        default 3000
        range 200 6000

    config RADAR_TRIGGER_ENERGY
        int "Energia minima del bersaglio in movimento per il trigger"
        default 20
        range 0 100

    config RADAR_CONFIRM_FRAMES
        int "Frame consecutivi di conferma del trigger"
        default 3
        range 1 10

    config RADAR_HOLD_MS
        int "Tenuta della presenza senza bersagli [ms]"
        default 3000
        range 0 60000

    config RADAR_HYSTERESIS_GATES
        int "Isteresi di uscita in cancelli di distanza"
        default 1
        range 0 4

    config RADAR_STATIC_TRIGGER
        bool "I bersagli solo fermi generano trigger (default: no)"
        default n

    config RADAR_MAX_MOVING_GATE
        int "Cancello massimo per bersagli in movimento (2..8)"
        default 8
        range 2 8

    config RADAR_MAX_STATIC_GATE
        int "Cancello massimo per bersagli fermi (2..8)"
        default 8
        range 2 8

    config RADAR_UNMANNED_S
        int "Durata 'nessuno presente' del modulo [s]"
        default 5
        range 0 65535

    config RADAR_FAULT_TIMEOUT_MS
        int "Silenzio UART oltre il quale il sensore e' in guasto [ms]"
        default 2000
        range 500 60000

    config RADAR_CAL_MARGIN
        int "Margine sopra il rumore nelle soglie proposte dalla calibrazione"
        default 10
        range 0 100

    config RADAR_CAL_SECONDS
        int "Durata di default della calibrazione [s]"
        default 60
        range 10 600

    config RADAR_TASK_STACK
        int "Stack del task radar [byte]"
        default 4096

endmenu
```
