## components/radar_ld2420/Kconfig
```kconfig
menu "Radar LD2420"

    config RADAR_UART_NUM
        int "UART periferica del radar"
        default 1
        range 0 2

    config RADAR_BAUD
        int "Baud rate (0 = auto-probe 115200/256000 secondo firmware del modulo)"
        default 0

    config RADAR_RX_GPIO
        int "GPIO RX (collegato alla seriale dati del modulo: OT2 fw<1.5.3, OT1 fw>=1.5.3)"
        default 26

    config RADAR_TX_GPIO
        int "GPIO TX (collegato al pin RX del modulo)"
        default 27

    config RADAR_OUT_GPIO
        int "GPIO dell'uscita presenza del modulo (OT1 fw<1.5.3, OT2 fw>=1.5.3)"
        default 25

    config RADAR_OUT_ENABLE
        bool "Usa l'uscita presenza del modulo come controllo incrociato / modalita degradata"
        default y

    config RADAR_EN_GPIO
        int "GPIO RADAR_EN (-1 = non cablato)"
        default -1
        range -1 48

    config RADAR_RX_BUFFER
        int "Buffer RX UART [byte]"
        default 1024
        range 1024 8192

    config RADAR_TRIGGER_MM
        int "Distanza di trigger [mm]"
        default 3000
        range 200 8000

    config RADAR_CONFIRM_FRAMES
        int "Frame consecutivi di conferma del trigger"
        default 3
        range 1 10

    config RADAR_HOLD_MS
        int "Tenuta della presenza senza bersagli [ms]"
        default 3000
        range 0 60000

    config RADAR_HYSTERESIS_MM
        int "Isteresi di uscita oltre la distanza di trigger [mm]"
        default 500
        range 0 2000

    config RADAR_MIN_GATE
        int "Cancello minimo di rilevazione (0..15)"
        default 1
        range 0 15

    config RADAR_MAX_GATE
        int "Cancello massimo di rilevazione (0..15, default di fabbrica 12)"
        default 12
        range 0 15

    config RADAR_UNMANNED_S
        int "Tenuta presenza del modulo [s] (parametro delay time)"
        default 5
        range 0 255

    config RADAR_FAULT_TIMEOUT_MS
        int "Silenzio UART oltre il quale il sensore e' in guasto [ms]"
        default 2000
        range 500 60000

    config RADAR_CAL_MOVE_PCT
        int "Soglia trigger proposta in calibrazione [% del picco di rumore]"
        default 250
        range 100 1000

    config RADAR_CAL_STILL_PCT
        int "Soglia keep proposta in calibrazione [% del picco di rumore]"
        default 225
        range 100 1000

    config RADAR_CAL_SECONDS
        int "Durata di default della calibrazione [s]"
        default 60
        range 10 600

    config RADAR_TASK_STACK
        int "Stack del task radar [byte]"
        default 4096

    config RADAR_TASK_WDT
        bool "Iscrivi il task radar al task watchdog"
        default y
        help
            Il task radar (poll UART e recovery) si alimenta a ogni giro:
            il loop e' gia' a passi limitati (poll RX, attese richieste e
            boot entrambi con timeout), quindi il feed non cambia i tempi.

endmenu
```

## components/sys_health/Kconfig
```kconfig
menu "Salute di sistema"

    config SYS_HEALTH_TASK_WDT
        bool "Iscrivi il task di telemetria al task watchdog"
        default y
        help
            Il task di telemetria ha un periodo (SYS_HEALTH_PERIOD_S, di
            default 60 s) oltre il timeout di 5 s del watchdog: attende a
            passi da 1 s e si alimenta a ogni passo, conservando il periodo.

    config SYS_HEALTH_PERIOD_S
        int "Periodo telemetria stabilita' e task [s]"
        default 60
        range 10 3600
        help
            A ogni periodo il task pubblica status/stability e status/tasks
            (non retained) quando MQTT e' connesso.

endmenu
```

## components/wifi_prov/Kconfig
```kconfig
menu "Pumpkin wifi provisioning"

    choice PUMPKIN_PROV_SCHEME
        prompt "Transport di provisioning"
        default PUMPKIN_PROV_SCHEME_BLE
        help
            BLE (NimBLE) e il transport predefinito; SoftAP resta
            disponibile e non richiede lo stack BT nel build.

    config PUMPKIN_PROV_SCHEME_BLE
        bool "BLE (NimBLE)"
        depends on BT_NIMBLE_ENABLED
        help
            Provisioning via BLE con GATT: il manager rilascia controller
            e memoria BTDM appena finito (handler FREE_BTDM).

    config PUMPKIN_PROV_SCHEME_SOFTAP
        bool "SoftAP"
        help
            Provisioning via access point + HTTP: la memoria BT viene
            rilasciata subito all'init e il BT non viene mai inizializzato.

    endchoice

    config PUMPKIN_PROV_TIMEOUT_S
        int "Timeout della sessione di provisioning (s)"
        default 600
        range 30 86400
        help
            Allo scadere il servizio di provisioning viene fermato e viene
            postato PROV_EVENT_TIMEOUT sul loop default.

    config PUMPKIN_PROV_BTN_GPIO
        int "GPIO del bottone di provisioning"
        default 32
        range 0 39
        help
            Input con pull-up interno, attivo basso verso massa; fuori
            dall'intervallo valido il task del bottone non parte. Evitare
            i GPIO 6-11 (flash), 34-39 (senza pull-up) e gli strapping.

    config PUMPKIN_PROV_BTN_HOLD_MS
        int "Durata della pressione lunga del bottone (ms)"
        default 5000
        range 500 60000
        help
            Pressione continua per almeno questa durata per avviare il
            provisioning; un solo avvio per pressione.

    config PUMPKIN_PROV_SERVICE_PREFIX
        string "Prefisso del service name / SSID"
        default "PUMPKIN"
        help
            Il nome completo e il prefisso piu i 3 byte finali del MAC STA
            in esadecimale MAIUSCOLO (es. PUMPKIN-A1B2C3); vale per il nome
            BLE (advertisement/NVS) e per l'SSID SoftAP.

endmenu
```
